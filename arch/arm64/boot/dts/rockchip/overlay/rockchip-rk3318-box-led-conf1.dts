/dts-v1/;
/plugin/;

#include <dt-bindings/gpio/gpio.h>
#include <dt-bindings/input/input.h>
#include <dt-bindings/pinctrl/rockchip.h>

&gpio_led {

	working {
		gpios = <&gpio2 RK_PC7 GPIO_ACTIVE_HIGH>;
		linux,default-trigger = "mmc2";
	};

	/*
		* no auxiliary led on YX_RK3328 boards
		*
	auxiliary {
		gpios = <&gpio0 RK_PA1 GPIO_ACTIVE_HIGH>;
		label = "auxiliary";
		linux,default-trigger = "mmc2";
		default-state = "off";
		pinctrl-names = "default";
		pinctrl-0 = <&gpio_led_aux>;
	};
	*/

};

/*
 * TODO: needs to find the GPIO for this
 *
&gpio_keys {

	reset {
		gpios = <&gpio3 RK_PD1 GPIO_ACTIVE_LOW>;
		label = "reset";
		linux,code = <KEY_RESTART>;
		debounce-interval = <200>;
		wakeup-source;
	};

};
*/
